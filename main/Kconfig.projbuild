## main/Kconfig.projbuild
```kconfig
menu "WI-FI Configuration"

config WIFI_SSID
    string "Wi-Fi SSID"

config WIFI_PASSWORD
    string "Wi-Fi Password"

endmenu

menu "MQTT Configuration"

config BROKER_URI
    string "MQTT Broker URI (mqtt://host:port or mqtts://)"

config MQTT_USERNAME
    string "MQTT Username"

config MQTT_PASSWORD
    string "MQTT Password"

config MQTT_DISCOVERY_PREFIX
    string "Home Assistant discovery prefix"
    default "homeassistant"

config NODE_NAMESPACE
    string "Node namespace/prefix for topics"
    default "nixie-clock-in-14"

config NODE_ADD_SUFFIX
    bool "Append unique suffix to node name"
    default n

endmenu

menu "OTA Configuration"

config OTA_PUSH_PORT
    int "Authenticated OTA push TCP port (0 disables push)"
    range 0 65535
    default 3232

config OTA_PUSH_KEY
    string "OTA push AES-256 key (64 hexadecimal digits)"
    default ""
    help
        Shared AES-256-GCM key, entered as exactly 64 hexadecimal digits.
        Use a randomly generated key. Push OTA is disabled unless valid.

endmenu
```
